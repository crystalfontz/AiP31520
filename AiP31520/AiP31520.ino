//==============================================================================
//
//  CRYSTALFONTZ
//  The controller is an Wuxi i-core AiP31520
//    https://www.crystalfontz.com/controllers/Wuxi/AiP31520/
//
//  Seeeduino v4.2, an open-source 3.3v capable Arduino clone.
//    https://www.seeedstudio.com/Seeeduino-V4.2-p-2517.html
//    https://github.com/SeeedDocument/SeeeduinoV4/raw/master/resources/Seeeduino_v4.2_sch.pdf
//
//==============================================================================
// This is free and unencumbered software released into the public domain.
//
// Anyone is free to copy, modify, publish, use, compile, sell, or
// distribute this software, either in source code form or as a compiled
// binary, for any purpose, commercial or non-commercial, and by any
// means.
//
// In jurisdictions that recognize copyright laws, the author or authors
// of this software dedicate any and all copyright interest in the
// software to the public domain. We make this dedication for the benefit
// of the public at large and to the detriment of our heirs and
// successors. We intend this dedication to be an overt act of
// relinquishment in perpetuity of all present and future rights to this
// software under copyright law.
//
// THE SOFTWARE IS PROVIDED "AS IS", WITHOUT WARRANTY OF ANY KIND,
// EXPRESS OR IMPLIED, INCLUDING BUT NOT LIMITED TO THE WARRANTIES OF
// MERCHANTABILITY, FITNESS FOR A PARTICULAR PURPOSE AND NONINFRINGEMENT.
// IN NO EVENT SHALL THE AUTHORS BE LIABLE FOR ANY CLAIM, DAMAGES OR
// OTHER LIABILITY, WHETHER IN AN ACTION OF CONTRACT, TORT OR OTHERWISE,
// ARISING FROM, OUT OF OR IN CONNECTION WITH THE SOFTWARE OR THE USE OR
// OTHER DEALINGS IN THE SOFTWARE.
//
// For more information, please refer to <http://unlicense.org/>
//==============================================================================
// LCD parallel 6800 pins and control lines on Seeeduino:
// Seeduino    |  Port  | LCD
// ------------+--------+-------------
// #8/D8       |  PB0   | D/I (data/instruction)
// #9/D9       |  PB1   | R/W (read/write)
// #10/D10     |  PB2   | CS1 (column select 1/chip enable IC1)
// #11/D11     |  PB3   | CS2 (column select 2/chip enable IC2)
// #0-7/D0-7   |  PD0-7 | DB0-DB7 (data bus lines)
//
// you also need to control the contrast with a variable resistor,
// please refer the datasheet schematic for connection details
//==============================================================================
#include <Arduino.h>

// define the Arduino pin locations as per the table above
#define DI (8)
#define RW (9)
#define CS1 (10)
#define CS2 (11)
#define datapins (PORTD)

// define clear and set commands for each of the pins
#define DI_MASK (0x01)
#define CLR_DI (PORTB &= ~(DI_MASK))
#define SET_DI (PORTB |= (DI_MASK))

#define RW_MASK (0x02)
#define CLR_RW (PORTB &= ~(RW_MASK))
#define SET_RW (PORTB |= (RW_MASK))

#define CS1_MASK (0x04)
#define CLR_CS1 (PORTB &= ~(CS1_MASK))
#define SET_CS1 (PORTB |= (CS1_MASK))

#define CS2_MASK (0x08)
#define CLR_CS2 (PORTB &= ~(CS2_MASK))
#define SET_CS2 (PORTB |= (CS2_MASK))

// define columns/chip enables
#define chip1 (0x01)
#define chip2 (0x02)
#define bchip (0x03)

// page addresses
// page 0 - 0xB8
// page 1 - 0XB9
// page 2 - 0xBA
// page 3 - 0xBB

// initialization commands
#define SoftwareReset (0xE2)
#define DisplayStatus (0xAF) // turn display on
#define StartLine (0xC0)     // start line set to zero
#define StartPage (0xB8)     // start page set to zero
#define StartCol (0x00)      // start column set to zero
#define StaticDrive (0xA4)   // turn static drive off
#define DutySelect (0xA9)    // set duty to 1/32
#define Mapping (0xA0)       // set normal mapping

void sendCommand(uint8_t chip, uint8_t command)
{
    // to send a command/instruction, DI has to be pulled low
    CLR_DI;
    delay(10);
    datapins = command;

    // in this case, the column select/chip enable signals act as the enable signal to push the instruction
    if (chip == chip1)
    {
        SET_CS1;
        CLR_CS2;
    }
    else if (chip == chip2)
    {
        SET_CS2;
        CLR_CS1;
    }
    else if (chip == bchip)
    {
        SET_CS1;
        SET_CS2;
    }

    delay(10);
    // deselect the chips
    CLR_CS1;
    CLR_CS2;
}

void sendData(uint8_t chip, uint8_t data)
{
    // to send data, DI has to be pulled high
    SET_DI;
    delay(10);
    datapins = data;

    if (chip == chip1)
    {
        SET_CS1;
        CLR_CS2;
    }
    else if (chip == chip2)
    {
        SET_CS2;
        CLR_CS1;
    }
    else if (chip == bchip)
    {
        SET_CS1;
        SET_CS2;
    }

    delay(10);
    // deselect the chips
    CLR_CS1;
    CLR_CS2;
    // pull DI low for instructions
    CLR_DI;
}

void init_display()
{
    // initialize the display by issuing a software reset and other commands mentioned above
    // initialization commands are issued to both chips
    sendCommand(bchip, SoftwareReset);
    sendCommand(bchip, Mapping);
    sendCommand(bchip, StaticDrive);
    sendCommand(bchip, DutySelect);
    sendCommand(bchip, StartLine);
    sendCommand(bchip, StartPage);
    sendCommand(bchip, StartCol);
    sendCommand(bchip, DisplayStatus);
}

void writeAddress(uint8_t page, uint8_t segment)
// when writing to the display, the page and column to be written to has to be specified
{
    sendCommand(bchip, page);
    sendCommand(bchip, segment);
}

void fillHalf()
{
    uint8_t x, y;
    // select page 0, column 0
    writeAddress(0xB8, 0x00);
    for (y = 0; y < 4; y++)
    {
        // scroll through pages 0-3
        writeAddress(0xB8 + y, 0x00);
        for (x = 0; x < 61; x++)
        {
            // write black to the first chip (half of the display)
            sendData(chip1, 0xff);
        }
        for (x = 0; x < 61; x++)
        {
            // write white/clear to the second chip (second half of the display)
            sendData(chip2, 0x00);
        }
    }
}

void vertLine()
{
    uint8_t x, y;
    // select page 0, column 0
    writeAddress(0xB8, 0x00);
    for (y = 0; y < 4; y++)
    {
        // scroll through pages 0-3
        writeAddress(0xB8 + y, 0x00);
        for (x = 0; x < 30; x++)
        {
            sendData(chip1, 0xff);
            sendData(chip1, 0x00);
        }
        sendData(chip1, 0xff);
        for (x = 0; x < 30; x++)
        {
            sendData(chip2, 0x00);
            sendData(chip2, 0xff);
        }
        sendData(chip2, 0x00);
    }
}

void crossDot()
{
    uint8_t x, y;
    // select page 0, column 0
    writeAddress(0xB8, 0x00);
    for (y = 0; y < 4; y++)
    {
        // scroll through pages 0-3
        writeAddress(0xB8 + y, 0x00);
        for (x = 0; x < 30; x++)
        {
            sendData(chip1, 0xAA);
            sendData(chip1, 0x55);
        }
        sendData(chip1, 0xAA);
        for (x = 0; x < 30; x++)
        {
            sendData(chip2, 0x55);
            sendData(chip2, 0xAA);
        }
        sendData(chip2, 0x55);
    }
}

// uint8_t picture[4][122]={//CFA logo for CFAG12232J1
// {0x00,0x00,0x00,0x00,0x00,0x80,0xC0,0xE0,0xF0,0xF0,0x38,0x1C,0x0E,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0x00,0x00},
// {0x00,0x00,0xFE,0xFE,0xFE,0xFE,0xFE,0xFE,0xFE,0xFE,0xFE,0xFE,0xFE,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0x00,0x00},
// {0x00,0x00,0x7F,0x7F,0x7F,0x7F,0x7F,0x7F,0x7F,0x7F,0x7F,0x7F,0x7F,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0xF0,0x00},
// {0x00,0x00,0x00,0x00,0x00,0x01,0x03,0x07,0x0F,0x0F,0x1C,0x38,0x70,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0x3F,0x00}
// };

uint8_t picture[4][122] = { // CFA logo for CFAG12232D1
    {0x00, 0x00, 0x00, 0x00, 0x00, 0x80, 0xC0, 0xE0, 0xF0, 0xF0, 0x38, 0x1C, 0x0E,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 0x00, 0x00},
    {0x00, 0x00, 0xFE, 0xFE, 0xFE, 0xFE, 0xFE, 0xFE, 0xFE, 0xFE, 0xFE, 0xFE, 0xFE,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 0x00, 0x00},
    {0x00, 0x00, 0x7F, 0x7F, 0x7F, 0x7F, 0x7F, 0x7F, 0x7F, 0x7F, 0x7F, 0x7F, 0x7F,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 0xF0, 0x00},
    {0x00, 0x00, 0x00, 0x00, 0x00, 0x01, 0x03, 0x07, 0x0F, 0x0F, 0x1C, 0x38, 0x70,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 0x3F, 0x00}};

void showPic()
{
    uint8_t x, y;
    // select page 0, column 0
    writeAddress(0xB8, 0x00);
    for (y = 0; y < 4; y++)
    {
        // scroll through pages 0-3
        writeAddress(0xB8 + y, 0x00);
        for (x = 0; x < 61; x++)
        {
            sendData(chip1, picture[y][x]);
        }
        for (x = 61; x < 122; x++)
        {
            sendData(chip2, picture[y][x]);
        }
    }
}

void setup()
{
    // set pin directions as outputs
    DDRD = 0xFF;
    DDRB = 0x0F;
    // set the pins at an appropriate starting state
    datapins = 0;
    SET_DI;
    CLR_RW; // since this example code does not have a read function we can set this once and forget it
    CLR_CS1;
    CLR_CS2;

    init_display(); // initialize the display
}

void loop()
{
    crossDot();
    delay(5000);
    vertLine();
    delay(5000);
    fillHalf();
    delay(5000);
    showPic();
    delay(50000);
}
